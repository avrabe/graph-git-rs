## meta-test/conf/layer.conf
```bitbake
# Test layer configuration

# We have a conf and classes directory, add to BBPATH
BBPATH .= ":${LAYERDIR}"

# We have recipes-* directories, add to BBFILES
BBFILES += "${LAYERDIR}/recipes-*/*/*.bb \
            ${LAYERDIR}/recipes-*/*/*.bbappend"

BBFILE_COLLECTIONS += "meta-test"
BBFILE_PATTERN_meta-test = "^${LAYERDIR}/"
BBFILE_PRIORITY_meta-test = "10"

LAYERDEPENDS_meta-test = "core"
LAYERSERIES_COMPAT_meta-test = "scarthgap"
```
