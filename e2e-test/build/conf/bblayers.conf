## e2e-test/build/conf/local.conf
```bitbake
#
# local.conf - Generated by Bitzel from kas configuration
#

MACHINE ?= "qemuarm64"
DISTRO ?= "poky"

# Build directories
TMPDIR = "${TOPDIR}/tmp"
DL_DIR ?= "${TOPDIR}/downloads"
SSTATE_DIR ?= "${TOPDIR}/sstate-cache"

# Bitzel cache (Bazel-style CAS)
BITZEL_CACHE_DIR ?= "${TOPDIR}/bitzel-cache"

# Custom configuration from kas
# Section: build-settings
# Disk space monitoring
BB_DISKMON_DIRS = "\\
    STOPTASKS,${TMPDIR},1G,100K \\
    STOPTASKS,${DL_DIR},1G,100K \\
    STOPTASKS,${SSTATE_DIR},1G,100K \\
    STOPTASKS,/tmp,100M,100K \\
    HALT,${TMPDIR},100M,1K \\
    HALT,${DL_DIR},100M,1K \\
    HALT,${SSTATE_DIR},100M,1K \\
    HALT,/tmp,10M,1K"

# Package management
PACKAGE_CLASSES = "package_rpm"

# Remove documentation for smaller images
INHERIT += "rm_work"

# SDK settings for ARM64
SDKMACHINE = "aarch64"


# Package management
PACKAGE_CLASSES ?= "package_ipk"

# Build parallelism
BB_NUMBER_THREADS ?= "${@oe.utils.cpu_count()}"
PARALLEL_MAKE ?= "-j ${@oe.utils.cpu_count()}"
```

## e2e-test/build/hitzeleiter-cache/sandboxes/4e188081-b2f1-490d-95fe-68b1cad1dc72/work/defconfig
```kconfig
# Minimal busybox configuration
CONFIG_DESKTOP=y
CONFIG_EXTRA_COMPAT=y
CONFIG_FEATURE_DEVPTS=y
CONFIG_LFS=y
```
